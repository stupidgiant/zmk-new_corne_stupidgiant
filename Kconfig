## Kconfig
```kconfig
# SPDX-License-Identifier: MIT

config ZMK_LAYER_LIGHTS
    bool "Light the keys that do something on the active layer"
    default y
    depends on DT_HAS_ZMK_BEHAVIOR_LAYER_LIGHTS_ENABLED
    depends on ZMK_RGB_UNDERGLOW

if ZMK_LAYER_LIGHTS

config ZMK_LAYER_LIGHTS_BRIGHTNESS
    int "Layer light brightness, in percent"
    range 1 100
    default 35

endif # ZMK_LAYER_LIGHTS
```

## boards/shields/bee_view/Kconfig.defconfig
```kconfig
# SPDX-License-Identifier: MIT
#
# bee_view: a custom status screen for the nice!view (control-room readouts on
# the left half, an animated bee on the right half).

if SHIELD_BEE_VIEW

config LV_Z_VDB_SIZE
    default 100

config LV_DPI_DEF
    default 161

config LV_Z_BITS_PER_PIXEL
    default 1

choice LV_COLOR_DEPTH
    default LV_COLOR_DEPTH_1
endchoice

choice ZMK_DISPLAY_WORK_QUEUE
    default ZMK_DISPLAY_WORK_QUEUE_DEDICATED
endchoice

choice ZMK_DISPLAY_STATUS_SCREEN
    default ZMK_DISPLAY_STATUS_SCREEN_CUSTOM
endchoice

config LV_Z_MEM_POOL_SIZE
    default 4096 if ZMK_DISPLAY_STATUS_SCREEN_CUSTOM

config ZMK_DISPLAY_STATUS_SCREEN_CUSTOM
    imply BEE_VIEW_WIDGET

config BEE_VIEW_WIDGET
    bool "bee_view status screen"
    select LV_USE_CANVAS

config BEE_VIEW_INVERTED
    bool "Dark pixels on a light background instead of light on dark"

config BEE_VIEW_LOW_BATTERY
    int "Battery percentage at or below which the low power alert shows"
    default 15

if !ZMK_SPLIT || ZMK_SPLIT_ROLE_CENTRAL

config BEE_VIEW_WIDGET
    select ZMK_WPM

# Lets the left half show the right half's battery.
config ZMK_SPLIT_BLE_CENTRAL_BATTERY_LEVEL_FETCHING
    default y

endif # !ZMK_SPLIT || ZMK_SPLIT_ROLE_CENTRAL

endif # SHIELD_BEE_VIEW
```

## boards/shields/bee_view/Kconfig.shield
```kconfig
# SPDX-License-Identifier: MIT

config SHIELD_BEE_VIEW
    def_bool $(shields_list_contains,bee_view)
```

## dts/bindings/behaviors/zmk,behavior-layer-lights.yaml
```yaml
# SPDX-License-Identifier: MIT

description: |
  Lights the per-key LEDs under the keys that do something on the active layer.
  The left half works out which keys those are and tells the right half through
  this behavior. Binding it to a key with LYL_CALIBRATE starts LED calibration.

compatible: "zmk,behavior-layer-lights"

include: two_param.yaml

properties:
  layers:
    type: array
    required: true
    description: Layer numbers that get lights, counted from 0 in keymap order.
  colors:
    type: array
    required: true
    description: One 0xRRGGBB color per entry in layers.
  calibration-layer:
    type: int
    description: |
      Layer to hold active during LED calibration, so that the key presses do
      nothing. Give it a layer whose keys are all &none.
```
